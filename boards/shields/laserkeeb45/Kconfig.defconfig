## boards/shields/laserkeeb45/Kconfig.defconfig
```kconfig
if SHIELD_LASERKEEB45

config ZMK_KEYBOARD_NAME
    default "LASERkeeb45"

endif
```

## boards/shields/laserkeeb45/Kconfig.shield
```kconfig
# Copyright (c) 2021 The ZMK Contributors
# SPDX-License-Identifier: MIT

config SHIELD_LASERKEEB45
    def_bool $(shields_list_contains,laserkeeb45)
```
